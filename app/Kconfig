## app/Kconfig
```kconfig
choice
	prompt "Heartbeat Period"
	default HEARTBEAT_500MS

config HEARTBEAT_100MS
	bool "Very Fast (100ms)"

config HEARTBEAT_500MS
	bool "Fast (500ms)"

config HEARTBEAT_1000MS
	bool "Medium (1s)"

config HEARTBEAT_2000MS
	bool "Slow (2s)"
endchoice

config APP_HEARTBEAT_PERIOD_MS
	int
	range 100 2000
    default 100 if HEARTBEAT_100MS
	default 500 if HEARTBEAT_500MS
	default 1000 if HEARTBEAT_1000MS
	default 2000 if HEARTBEAT_2000MS
	default 500

source "Kconfig.zephyr"
```

## build_cmake/Kconfig/arch/Kconfig
```kconfig
# Load Zephyr Arch Kconfig descriptions.
osource "/home/motaha/zephyrproject/zephyr/arch/rx/Kconfig"
osource "/home/motaha/zephyrproject/zephyr/arch/x86/Kconfig"
osource "/home/motaha/zephyrproject/zephyr/arch/xtensa/Kconfig"
osource "/home/motaha/zephyrproject/zephyr/arch/sparc/Kconfig"
osource "/home/motaha/zephyrproject/zephyr/arch/riscv/Kconfig"
osource "/home/motaha/zephyrproject/zephyr/arch/posix/Kconfig"
osource "/home/motaha/zephyrproject/zephyr/arch/openrisc/Kconfig"
osource "/home/motaha/zephyrproject/zephyr/arch/mips/Kconfig"
osource "/home/motaha/zephyrproject/zephyr/arch/arm64/Kconfig"
osource "/home/motaha/zephyrproject/zephyr/arch/arm/Kconfig"
osource "/home/motaha/zephyrproject/zephyr/arch/arc/Kconfig"
```

## build_cmake/Kconfig/boards/Kconfig.defconfig
```kconfig
# Load Zephyr board defconfig descriptions.
osource "/home/motaha/zephyrproject/zephyr/boards/others/stm32_min_dev/Kconfig.defconfig"
```

## build_cmake/Kconfig/boards/Kconfig.stm32_min_dev
```kconfig
# Load board Kconfig descriptions.
osource "/home/motaha/zephyrproject/zephyr/boards/others/stm32_min_dev/Kconfig.stm32_min_dev"
```

## build_cmake/Kconfig/boards/Kconfig.sysbuild
```kconfig
# Load Sysbuild board Kconfig descriptions.
osource "/home/motaha/zephyrproject/zephyr/boards/others/stm32_min_dev/Kconfig.sysbuild"
```
